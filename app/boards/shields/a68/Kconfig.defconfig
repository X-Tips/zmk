## app/boards/shields/a68/Kconfig.defconfig
```kconfig
# Copyright (c) 2020 The ZMK Contributors
# SPDX-License-Identifier: MIT

if SHIELD_SKEW68

config ZMK_KEYBOARD_NAME
	default "skew68"

endif
```
